#include <SPI.h>
#include <Wire.h>
#include <Adafruit_GFX.h>
#include <Adafruit_SH110X.h>

#define SCREEN_WIDTH 128
#define SCREEN_HEIGHT 64

#define OLED_DC     9
#define OLED_CS    10  
#define OLED_RESET  8   



//U8G2_SSD1306_128X64_NONAME_F_4W_HW_SPI u8g2(U8G2_R0, /* cs=*/ 10, /* dc=*/ 9, /* reset=*/ 8);
//U8G2_SSD1306_128X64_NONAME_F_4W_HW_SPI u8g2(U8G2_R0, /* cs=*/ 10, /* dc=*/ 9, /* reset=*/ 8);
//U8G2_SH1106_128X64_NONAME_F_4W_HW_SPI u8g2(U8G2_R0, /* cs=*/ 10, /* dc=*/ 9, /* reset=*/ 8);

Adafruit_SH1106G display = Adafruit_SH1106G(SCREEN_WIDTH, SCREEN_HEIGHT, &SPI, OLED_DC, OLED_RESET, OLED_CS);

// 'Tamagochi', 128x64px
const unsigned char epd_bitmap_Tamagochi [] PROGMEM = {
	0x00, 0x00, 0x00, 0x00, 0x00, 0x00, 0x00, 0x00, 0x00, 0x00, 0x00, 0x00, 0x00, 0x00, 0x00, 0x00, 
	0x00, 0x00, 0x00, 0x00, 0x00, 0x00, 0x00, 0x00, 0x00, 0x00, 0x00, 0x00, 0x00, 0x00, 0x00, 0x00, 
	0x00, 0x00, 0x00, 0x00, 0x00, 0x00, 0x00, 0x00, 0x00, 0x00, 0x00, 0x00, 0x00, 0x00, 0x00, 0x00, 
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	0x00, 0x00, 0x00, 0x00, 0x00, 0x00, 0x00, 0x00, 0x00, 0x00, 0x00, 0x00, 0x00, 0x00, 0x00, 0x00
};

//---Meow Button---
const int BUTTON_PIN = 3;       // Gomb lába (a pin és a GND közé kötve)
bool lastButtonState = HIGH;     // INPUT_PULLUP miatt nyugalomban HIGH
unsigned long lastDebounceTime = 0;
const unsigned long DEBOUNCE_DELAY = 50;

// ---Floating Animation---
float floatingAngle = 0.0;     // A hullámzás aktuális szöge (radiánban)
const float floatSpeed = 0.08; // Lebegés sebessége (kisebb = lassabb, andalítóbb)
const int floatRange = 4;      // Kitérés pixelben (±4 pixel fel és le)

//---Buzzer--- 
const int BUZZER_PIN = 2;

const unsigned long MIN_INTERVAL = 2000;
const unsigned long MAX_INTERVAL = 6000;

const int FREQ_START = 450;
const int FREQ_END   = 1400;
const int FREQ_STEP  = 45;
const unsigned long STEP_DURATION = 2;

bool isPlaying = false;
int currentFreq = FREQ_START;
unsigned long lastStepTime = 0;
unsigned long lastBubbleEndTime = 0;
unsigned long nextInterval = 3000;

bool isPlayingMeow = false;

void setup() {
 
  display.begin(0, true);
/*
	display.clearDisplay();

	display.drawBitmap(0, 0, epd_bitmap_Tamagochi, 128, 64, SH110X_WHITE);

	display.display();
*/
	pinMode(BUZZER_PIN, OUTPUT);
  pinMode(BUTTON_PIN, INPUT_PULLUP);

  randomSeed(analogRead(A0));
  
  // Első véletlen időzítés beállítása
  nextInterval = random(MIN_INTERVAL, MAX_INTERVAL);
}

void loop() {

	upndown();

	checkButton();

	//bubbleSound();


}


void upndown() {
	display.clearDisplay();

	int offsetY = sin(floatingAngle) * floatRange;

	display.drawBitmap(0, offsetY, epd_bitmap_Tamagochi, 128, 64, SH110X_WHITE);

	display.display();

	floatingAngle += floatSpeed;
	if(floatingAngle >= 6.283)
	{
		floatingAngle = 0.0;
	}

	delay(25);
}

// Ezt a függvényt folyamatosan hívhatod a loop-ban
void bubbleSound() {
  unsigned long currentMillis = millis();

  // 1. ÁLLAPOT: Várakozás a következő buborékra
  if (!isPlaying) {
    if (currentMillis - lastBubbleEndTime >= nextInterval) {
      // Elérkezett az idő: indítjuk a buborékot
      isPlaying = true;
      currentFreq = FREQ_START;
      lastStepTime = currentMillis;
      tone(BUZZER_PIN, currentFreq);
    }
    return; // Még nem szól, visszatérünk a loop többi részéhez
  }

  // 2. ÁLLAPOT: A hang éppen fut (lépésről lépésre emeljük a frekvenciát)
  if (isPlaying) {
    if (currentMillis - lastStepTime >= STEP_DURATION) {
      lastStepTime = currentMillis;
      currentFreq += FREQ_STEP;

      if (currentFreq <= FREQ_END) {
        tone(BUZZER_PIN, currentFreq);
      } else {
        // Elértük a felső határt, vége a buboréknak
        noTone(BUZZER_PIN);
        isPlaying = false;
        lastBubbleEndTime = currentMillis;
        // Új véletlen idő kisorsolása a következő buborékig
        nextInterval = random(MIN_INTERVAL, MAX_INTERVAL);
      }
    }
  }
}

void checkButton() {
  int reading = digitalRead(BUTTON_PIN);

  // Pergésmentesített lenyomás-figyelés (HIGH -> LOW átmenet)
  if (reading != lastButtonState) {
    lastDebounceTime = millis();
  }

  if ((millis() - lastDebounceTime) > DEBOUNCE_DELAY) {
    // Ha a gombot most nyomták le
    static bool buttonProcessed = false;

    if (reading == LOW && !buttonProcessed) {
      buttonProcessed = true;
      triggerMeow(); // Nyávogás indítása prioritással
    } else if (reading == HIGH) {
      buttonProcessed = false;
    }
  }

  lastButtonState = reading;
}

void triggerMeow() {
  // 1. Ha épp fut a buborék, azonnal megszakítjuk
  if (isPlaying) {
    noTone(BUZZER_PIN);
    isPlaying = false;
  }

  // 2. Lejátsszuk a nyávogást
  MeowSound();

  // 3. Újraindítjuk a buborék időzítőjét, hogy ne közvetlenül a nyávogás után szóljon
  lastBubbleEndTime = millis();
  nextInterval = random(MIN_INTERVAL, MAX_INTERVAL);
}

void MeowSound() {

	if (!isPlaying && !isPlayingMeow) {
		// 1. Felvezetés: gyors emelkedés 700 Hz-ről ~1400 Hz-re
		for (int freq = 700; freq < 1400; freq += 25) {
			tone(BUZZER_PIN, freq);
			delay(4);
		}

		// 2. A nyávogás teteje / nyújtás (~1400 Hz - 1200 Hz környékén kis lebegtetés)
		for (int freq = 1400; freq > 1150; freq -= 10) {
			tone(BUZZER_PIN, freq);
			delay(8);
		}

		// 3. Lecsengés: lassú ereszkedés 1150 Hz-ről 500 Hz-re
		for (int freq = 1150; freq > 500; freq -= 15) {
			tone(BUZZER_PIN, freq);
			delay(10);
		}

		// Hang kikapcsolása a végén
		noTone(BUZZER_PIN);
	}
}